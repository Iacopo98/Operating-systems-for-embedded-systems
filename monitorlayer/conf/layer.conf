## monitorlayer/conf/layer.conf
```bitbake
# We have a conf and classes directory, add to BBPATH
BBPATH .= ":${LAYERDIR}"

# We have recipes-* directories, add to BBFILES
BBFILES += "${LAYERDIR}/recipes-*/*/*.bb \
            ${LAYERDIR}/recipes-*/*/*.bbappend"

BBFILE_COLLECTIONS += "monitorlayer"
BBFILE_PATTERN_monitorlayer = "^${LAYERDIR}/"
BBFILE_PRIORITY_monitorlayer = "6"

LAYERDEPENDS_monitorlayer = "core"
LAYERSERIES_COMPAT_monitorlayer = "dunfell"
```
